#include <input/processors.dtsi>
#include <behaviors.dtsi>
#include <dt-bindings/zmk/keys.h>
#include <dt-bindings/zmk/pointing.h>
#include <dt-bindings/zmk/bt.h>
#include <dt-bindings/zmk/input_transform.h>
#include <input/processors.dtsi>
#include <dt-bindings/zmk/outputs.h>

/ {
  trackball_listener {
    lowspeedmode {
        layers = <4>;
        input-processors = <
          &zip_xy_transform (INPUT_TRANSFORM_X_INVERT | INPUT_TRANSFORM_Y_INVERT)
          &zip_x_scaler 1 50
          &zip_y_scaler 1 50
        >;
    };
    scroller {
        layers = <1>;
        input-processors = <
          &zip_xy_transform (INPUT_TRANSFORM_Y_INVERT)
          &zip_x_scaler 0 50  // disable x scroller
          &zip_y_scaler 1 50
          &zip_xy_to_scroll_mapper
        >;
    };
  };

   td0: tap_dance_0 {
    compatible = "zmk,behavior-tap-dance";
      #binding-cells = <0>;
      tapping-term-ms = <200>;
      bindings = <&lt 4 &mkp MB2>;
       };
  };

  combos {
    compatible = "zmk,combos";
    combo_bt_clear_all {
      timeout-ms = <50>;
      key-positions = <0 1 2 3>;
      bindings = <&bt BT_CLR_ALL>;
    };
  };

  keymap {
    compatible = "zmk,keymap";
    default_layer {
      bindings = <
        &mkp MB1 &mkp MB2
        &mo 4    &mo 1 
      >;
    };

    1 {
      bindings = <
        &mkp MB4 &mkp MB5
        &mo 2    &trans
      >;
    };

    2 {
      bindings = <
        &bt BT_SEL 0 &out OUT_TOG
        &trans       &mo 3
      >;
    };

    3 {
      bindings = <
        &bt BT_SEL 1   &bt BT_SEL 2
        &bt BT_CLR     &trans
      >;
    };

    4 {
      bindings = <
        &mkp MB1       &trans
        &trans         &trans
      >;
    };
  };
};
